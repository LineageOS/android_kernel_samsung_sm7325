## arch/arm64/Kconfig.projects
```kconfig
config SEC_A52SXQ_PROJECT
	default n
	bool "Samsung A52SXQ Project"
	help
	  Support for Samsung A52SXQ Project

config MACH_A52SXQ_EUR_OPEN
	default n
	bool "Samsung A52SXQ EUR OPEN"
	help
	  Support for Samsung A52SXQ EUR OPEN device.

config SEC_M52XQ_PROJECT
	depends on ARCH_YUPIK
	default n
	bool "Samsung M52XQ Project"
	help
	  Support for Samsung M52XQ Project

config MACH_M52XQ_EUR_OPEN
	depends on SEC_M52XQ_PROJECT
	default n
	bool "Samsung M52XQ EUR OPEN"
	help
	  Support for Samsung M52XQ EUR OPEN device.
```
